## sdkconfig.defaults
```kconfig
# TCP 发送/接收窗口从默认 5760 扩大到 16384
# 默认值太小，传输 100KB+ 的文件需要大量 RTT 轮次，导致页面加载极慢
# 每个连接额外消耗约 32KB 堆，ESP32C3 堆空间充足
CONFIG_LWIP_TCP_SND_BUF_DEFAULT=16384
CONFIG_LWIP_TCP_WND_DEFAULT=16384

# HTTP 服务器同时处理的最大请求数
CONFIG_HTTPD_MAX_REQ_HDR_LEN=1024

# 启用 WebSocket，用于实时推送 esp_log 到前端
CONFIG_HTTPD_WS_SUPPORT=y

# 分区改为双 OTA 大分区（4MB Flash）
CONFIG_PARTITION_TABLE_TWO_OTA_LARGE=y

# Flash 大小设置为 4MB（与分区表匹配，避免 CI 报 2MB 不足）
CONFIG_ESPTOOLPY_FLASHSIZE_4MB=y

# 产物体积优化：从 Debug 切换到 Size，降低后续 OTA 空间压力
CONFIG_COMPILER_OPTIMIZATION_SIZE=y
CONFIG_COMPILER_OPTIMIZATION_ASSERTIONS_ENABLE=y

# 精简固件元信息和默认日志等级
# CONFIG_APP_COMPILE_TIME_DATE is not set
CONFIG_LOG_DEFAULT_LEVEL_INFO=y
```
